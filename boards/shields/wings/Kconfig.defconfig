## boards/shields/wings/Kconfig.defconfig
```kconfig
if SHIELD_WINGS_LEFT

config ZMK_KEYBOARD_NAME
    default "Wings"

config ZMK_SPLIT_ROLE_CENTRAL
    default y

endif

if SHIELD_WINGS_ROW2COL_LEFT

config ZMK_KEYBOARD_NAME
    default "Wings"

config ZMK_SPLIT_ROLE_CENTRAL
    default y

endif

if SHIELD_WINGS_LEFT || SHIELD_WINGS_RIGHT || SHIELD_WINGS_ROW2COL_LEFT || SHIELD_WINGS_ROW2COL_RIGHT

config ZMK_SPLIT
    default y

endif
```

## boards/shields/wings/Kconfig.shield
```kconfig
# Copyright (c) 2020 The ZMK Contributors
# SPDX-License-Identifier: MIT

config SHIELD_WINGS_LEFT
    def_bool $(shields_list_contains,wings_left)

config SHIELD_WINGS_RIGHT
    def_bool $(shields_list_contains,wings_right)

config SHIELD_WINGS_ROW2COL_LEFT
    def_bool $(shields_list_contains,wings_row2col_left)

config SHIELD_WINGS_ROW2COL_RIGHT
    def_bool $(shields_list_contains,wings_row2col_right)
```
