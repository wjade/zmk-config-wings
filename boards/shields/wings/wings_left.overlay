/*
 * Copyright (c) 2020 The ZMK Contributors
 *
 * SPDX-License-Identifier: MIT
 */

#include "wings.overlay"

&kscan0 {
    col-gpios
        = <&xiao_d 4 GPIO_ACTIVE_HIGH>  // Column 0 - D4
        , <&xiao_d 5 GPIO_ACTIVE_HIGH>  // Column 1 - D5
        , <&xiao_d 6 GPIO_ACTIVE_HIGH>  // Column 2 - D6
        , <&xiao_d 7 GPIO_ACTIVE_HIGH>  // Column 3 - D7
        , <&xiao_d 8 GPIO_ACTIVE_HIGH>  // Column 4 - D8
        , <&xiao_d 9 GPIO_ACTIVE_HIGH>  // Column 5 - D9
        ;
};