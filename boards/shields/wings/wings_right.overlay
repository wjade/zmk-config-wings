/*
 * Copyright (c) 2020 The ZMK Contributors
 *
 * SPDX-License-Identifier: MIT
 */

#include "wings.overlay"

&default_transform {
    col-offset = <6>;
};

&kscan0 {
    col-gpios
        = <&xiao_d 4 GPIO_ACTIVE_HIGH>  // Column 6 - D4
        , <&xiao_d 5 GPIO_ACTIVE_HIGH>  // Column 7 - D5
        , <&xiao_d 0 GPIO_ACTIVE_HIGH>  // Column 8 - D0
        , <&xiao_d 1 GPIO_ACTIVE_HIGH>  // Column 9 - D1
        , <&xiao_d 2 GPIO_ACTIVE_HIGH>  // Column 10 - D2
        , <&xiao_d 3 GPIO_ACTIVE_HIGH>  // Column 11 - D3
        ;
};