/*
 * Minimal test keymap - just one key
 */

#include <behaviors.dtsi>
#include <dt-bindings/zmk/keys.h>

/ {
    keymap {
        compatible = "zmk,keymap";
        
        default_layer {
            bindings = <&kp A>;
        };
    };
};